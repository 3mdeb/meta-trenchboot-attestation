## conf/layer.conf
```bitbake
# We have a conf and classes directory, append to BBPATH
BBPATH .= ":${LAYERDIR}"

# We have a recipes directory, add to BBFILES
BBFILES += "${LAYERDIR}/recipes*/*/*.bb ${LAYERDIR}/recipes*/*/*.bbappend"

BBFILE_COLLECTIONS += "meta-tpm-attestation"
BBFILE_PATTERN_meta-tpm-attestation = "^${LAYERDIR}/"
BBFILE_PRIORITY_meta-tpm-attestation = "6"

LAYERDEPENDS_meta-tpm-attestation = "core openembedded-layer tpm2"
LAYERSERIES_COMPAT_meta-tpm-attestation = "zeus"
```
